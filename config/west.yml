## config/west.yml
```yaml
manifest:
  remotes:
    - name: KamronSmith
      url-base: https://github.com/KamronSmith
  projects:
    - name: zmk
      remote: KamronSmith
      revision: devel-adaptive
      import: app/west.yml
  self:
    path: config
```
